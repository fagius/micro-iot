## meta-linkit7688/conf/machine/linkit7688.conf
```bitbake
#@TYPE: Machine
#@NAME: linkit7688

#@DESCRIPTION: Machine configuration for linkit7688 systems

require conf/machine/include/mips/tune-mips-24k.inc
DEFAULTTUNE = "mips32r2-24kec"

MACHINE_FEATURES = "usbhost serial wifi"

KERNEL_IMAGETYPE = "vmlinux"
KERNEL_ALT_IMAGETYPE = "vmlinux.bin"
KERNEL_IMAGE_STRIP_EXTRA_SECTIONS  = ".comment"

PREFERRED_PROVIDER_virtual/kernel="linux-yocto-linkit7688"
PREFERRED_VERSION_linux-yocto-linkit7688 ?= "4.14%"

SERIAL_CONSOLE = "57600 ttyS2"
USE_VT ?= "0"

MACHINE_EXTRA_RRECOMMENDS = " kernel-modules"
DISTRO_FEATURES_append += " sysvinit wifi ipv4 ipv6"

MACHINE_FEATURES_BACKFILL_CONSIDERED += "rtc"

EXTRA_IMAGE_FEATURES += "read-only-rootfs"
IMAGE_ROOTFS_MAXSIZE="51000"
IMAGE_FSTYPES ?= "jffs2 tar.bz2"
JFFS2_ERASEBLOCK = "0x10000"

MACHINE_ESSENTIAL_EXTRA_RRECOMMENDS += "\
kernel-module-backports \
kernel-module-cdc-ether \
kernel-module-crc32c-generic \
kernel-module-ehci-hcd \
kernel-module-ehci-platform \
kernel-module-ext2 \
kernel-module-ext4 \
kernel-module-i2c-dev \
kernel-module-i2c-mt7621 \
kernel-module-kaweth \
kernel-module-mbcache \
kernel-module-mtk-mmc \
kernel-module-mtk-sd \
kernel-module-mtk_sd \
kernel-module-mmc-block \
kernel-module-mmc-core \
kernel-module-msdos \
kernel-module-mt76 \
kernel-module-mt7603e \
kernel-module-mt76x2e \
kernel-module-plusb \
kernel-module-r8152 \
kernel-module-rndis-host \
kernel-module-rtl8150 \
kernel-module-scsi-mod \
kernel-module-sdhci \
kernel-module-sd-mod \
kernel-module-snd-soc-ralink-i2s \
kernel-module-snd-soc-wm8960 \
kernel-module-snd-soc-simple-card \
kernel-module-snd-timer \
kernel-module-snd-pcm-dmaengine \
kernel-module-sound \
kernel-module-usb-storage \
"

KERNEL_MODULE_AUTOLOAD += " \
                           asix \
                           cdc_ether \
                           ehci-hcd \
                           ehci-platform \
                           ext4 \
                           lan78xx \
                           i2c-dev \
                           i2c-mt7621 \
                           kaweth \
                           mmc_core \
                           mmc_block \
                           mtk_sd \
                           mt7603e \
                           mt76 \
                           pegasus \
                           plusb \
                           r8152 \
                           rndis_host \
                           rtl8150 \
                           scsi_mod \
                           sd_mod \
 			   snd-soc-ralink-i2s \
 			   snd-soc-wm8960 \
 			   snd-soc-simple-card \
 			   snd-timer \
 			   snd-pcm-dmaengine \
                           usb-storage \
                           "

RDEPENDS_${KERNEL_PACKAGE_NAME}-base = ""

# Little Endian
TUNE_FEATURES_tune-mips-nf = "o32"
#
INHERIT += "buildhistory"
BUILDHISTORY_COMMIT = "1"
# Default to setting automatically based on cpu count
BB_NUMBER_THREADS = "${@oe.utils.cpu_count()}"
# Default to setting automatically based on cpu count
PARALLEL_MAKE = "-j ${@oe.utils.cpu_count()}"
```
